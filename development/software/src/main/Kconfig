## development/software/src/main/Kconfig
```kconfig
menu "Bluepad32 Custom Platform"

    choice BLUEPAD32_CUSTOM_PLATFORM
        bool "Target platform"
        default BLUEPAD32_PLATFORM_C64_BLUE
        help
            Select the Bluepad32 target custom platform.


        config BLUEPAD32_PLATFORM_C64_BLUE
            bool "c64-blue"
            help
                Targets "c64-blue" device.

    endchoice
endmenu
```

## development/software/src/sdkconfig.defaults
```kconfig
CONFIG_ESPTOOLPY_FLASHSIZE_4MB=y
CONFIG_PARTITION_TABLE_CUSTOM=y
CONFIG_COMPILER_OPTIMIZATION_PERF=y
CONFIG_BT_ENABLED=y
CONFIG_BT_CONTROLLER_ONLY=y
CONFIG_BTDM_CTRL_MODE_BTDM=y
CONFIG_BTDM_CTRL_BLE_MAX_CONN=5
CONFIG_BTDM_CTRL_BR_EDR_MAX_ACL_CONN=5
CONFIG_BTDM_CTRL_AUTO_LATENCY=y
# CONFIG_BTDM_CTRL_MODEM_SLEEP is not set
CONFIG_XTAL_FREQ_AUTO=y
CONFIG_ESP_SYSTEM_EVENT_TASK_STACK_SIZE=4096
CONFIG_ESP_MAIN_TASK_STACK_SIZE=16384
CONFIG_ESP_MINIMAL_SHARED_STACK_SIZE=4096
# CONFIG_ESP_TASK_WDT_EN is not set
CONFIG_ESP_COREDUMP_ENABLE_TO_FLASH=y
CONFIG_FATFS_LFN_STACK=y
CONFIG_FATFS_VFS_FSTAT_BLKSIZE=4096
CONFIG_FREERTOS_USE_TRACE_FACILITY=y
CONFIG_FREERTOS_USE_STATS_FORMATTING_FUNCTIONS=y
CONFIG_BLUEPAD32_PLATFORM_CUSTOM=y
CONFIG_BLUEPAD32_MAX_DEVICES=3
# CONFIG_BLUEPAD32_USB_CONSOLE_ENABLE is not set
CONFIG_BLUEPAD32_ENABLE_VIRTUAL_DEVICE_BY_DEFAULT=y
```
